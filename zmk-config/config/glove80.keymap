/* Copyright (c) 2020 The ZMK Contributors
 * SPDX-License-Identifier: MIT
 */

#include <behaviors.dtsi>
#include <dt-bindings/zmk/keys.h>
#include <dt-bindings/zmk/bt.h>
#include <dt-bindings/zmk/ext_power.h>
#include <dt-bindings/zmk/outputs.h>
#include <dt-bindings/zmk/rgb.h>

// layers
#define L0 0 // base 
#define NPAD 1
#define MAGIC 2
#define QWERTY 3
#define EXT 4
#define FN 5
#define SYM 6
#define L1 7

#define OSX_L0 8
#define OSX_NPAD 9
#define OSX_QWERTY 10
#define OSX_EXT 11
#define OSX_FN 12
#define OSX_SYM 13
#define OSX_L1 14

/* Convert NAME parameters into a ZMK label string */
/* Create a ZMK behavior without having to specify the name three times */
#define ALT_MORPH(NAME, STANDARD, MORPHED) \
    NAME: NAME { \
        compatible = "zmk,behavior-mod-morph"; \
        #binding-cells = <0>; \
        bindings = <STANDARD>, <MORPHED>; \
        mods = <(MOD_LALT)>; \
    };

#define SHIFT_MORPH(NAME, STANDARD, MORPHED) \
    NAME: NAME { \
        compatible = "zmk,behavior-mod-morph"; \
        #binding-cells = <0>; \
        bindings = <STANDARD>, <MORPHED>; \
        mods = <(MOD_LSFT|MOD_RSFT)>; \
    };

/ {
    behaviors {
        // For the "layer" key, it'd nice to be able to use it as either a shift or a toggle.
        // Configure it as a tap dance, so the first tap (or hold) is a &mo and the second tap is a &to
        layer_td: tap_dance_0 {
            compatible = "zmk,behavior-tap-dance";
            #binding-cells = <0>;
            tapping-term-ms = <200>;
            bindings = <&mo L1>, <&to L1>;
        };
        layer_td2: tap_dance_1 {
            compatible = "zmk,behavior-tap-dance";
            #binding-cells = <0>;
            tapping-term-ms = <200>;
            bindings = <&mo EXT>, <&to EXT>;
        };

    };
  };

 /{
   macros {
   undead_tilde: undead_tilde {
            compatible = "zmk,behavior-macro";
            #binding-cells = <0>;
            bindings
                = <&macro_press &kp RALT>
                , <&macro_tap &kp RBKT &kp RBKT>
                , <&macro_release &kp RALT>
                ;
          
    };
   undead_caret: undead_caret {
            compatible = "zmk,behavior-macro";
            #binding-cells = <0>;
            bindings
                = <&macro_press &kp LSFT>
                , <&macro_tap &kp RBKT &kp RBKT>
                , <&macro_release &kp LSFT>
                ;
          
    
    };

   undead_tick: undead_tick {
            compatible = "zmk,behavior-macro";
            #binding-cells = <0>;
            bindings
                = <&macro_press &kp LSFT>
                , <&macro_tap &kp EQUAL &kp EQUAL>
                , <&macro_release &kp LSFT>
                ;
    };
   tmux_fzf: tmux_fzf {
            compatible = "zmk,behavior-macro";
            #binding-cells = <0>;
            bindings
                = <&macro_tap &kp LC(B)>
                , <&macro_tap &kp LS(W)>
                ;
    };
 };
};


/ {
    behaviors {
        SHIFT_MORPH(dv_perc, &kp LS(N6), &kp LS(N5))
        SHIFT_MORPH(dv_dlr, &kp RA(N4), &undead_tilde)
        SHIFT_MORPH(dv_7, &kp RA(N8), &kp N7)
        SHIFT_MORPH(dv_5, &kp RA(N7), &kp N5)
        SHIFT_MORPH(dv_3, &kp RA(N0), &kp N3)
        SHIFT_MORPH(dv_1, &kp LS(N8), &kp N1)

        SHIFT_MORPH(dv_9, &kp LS(N0), &kp N9)
        SHIFT_MORPH(dv_0, &kp LS(BSLH), &kp N0)
        SHIFT_MORPH(dv_2, &kp LS(N9), &kp N2)
        SHIFT_MORPH(dv_4, &kp MINUS, &kp N4)
        SHIFT_MORPH(dv_6, &kp RA(N9), &kp N6)
        SHIFT_MORPH(dv_8, &kp LS(N1), &kp N8)
        SHIFT_MORPH(dv_semi, &kp LS(COMMA), &kp LS(DOT))
        SHIFT_MORPH(dv_sqt, &kp BSLH, &kp LS(N2))
        SHIFT_MORPH(dv_dot, &kp DOT, &kp LS(NON_US_BSLH))
        SHIFT_MORPH(dv_comma, &kp COMMA, &kp NON_US_BSLH)
        SHIFT_MORPH(dv_bslh, &kp GRAVE, &kp EQUAL) // \ |
        SHIFT_MORPH(dv_fslh, &kp LS(N7), &kp LS(MINUS)) // / ?
        SHIFT_MORPH(dv_minus, &kp FSLH, &kp LS(FSLH)) // -_
        SHIFT_MORPH(dv_ticks, &undead_tick, &kp LS(N3)) // ` #
        SHIFT_MORPH(dv_alpha, &kp RA(N2), &undead_caret) // @ ^

                    
        ALT_MORPH(dv_a, &kp A, &kp LBKT)
        ALT_MORPH(dv_o, &kp O, &kp SEMI)
        ALT_MORPH(dv_e, &kp E, &kp SQT)

        //SHIFT_MORPH(osx_dv_perc, &kp LS(N6), &kp LS(N5)) not used and wrong?
        SHIFT_MORPH(osx_dv_dlr, &kp LS(N4), &kp RA(RBKT)) // ok
        SHIFT_MORPH(osx_dv_7, &kp RA(N8), &kp N7) //  ok
        SHIFT_MORPH(osx_dv_5, &kp LS(RA(N8)), &kp N5) // ok
        SHIFT_MORPH(osx_dv_3, &kp LS(RA(N9)), &kp N3) // ok
        SHIFT_MORPH(osx_dv_1, &kp LS(N8), &kp N1) //  ok

        SHIFT_MORPH(osx_dv_9, &kp LS(N0), &kp N9) // ok
        SHIFT_MORPH(osx_dv_0, &kp LS(BSLH), &kp N0) // ok 
        SHIFT_MORPH(osx_dv_2, &kp LS(N9), &kp N2) // ok
        SHIFT_MORPH(osx_dv_4, &kp MINUS, &kp N4) // ok
        SHIFT_MORPH(osx_dv_6, &kp RA(N9), &kp N6) // ok
        SHIFT_MORPH(osx_dv_8, &kp LS(N1), &kp N8) // ok
        SHIFT_MORPH(osx_dv_semi, &kp LS(COMMA), &kp LS(DOT)) // ok
        SHIFT_MORPH(osx_dv_sqt, &kp NON_US_BSLH, &kp LS(N2)) // ok
        SHIFT_MORPH(osx_dv_dot, &kp DOT, &kp LS(NON_US_BSLH)) // 
        SHIFT_MORPH(osx_dv_comma, &kp COMMA, &kp NON_US_BSLH) // ok
        SHIFT_MORPH(osx_dv_bslh, &kp GRAVE, &kp EQUAL) // \ |
        SHIFT_MORPH(osx_dv_fslh, &kp LS(N7), &kp LS(MINUS)) // / ?
        SHIFT_MORPH(osx_dv_minus, &kp FSLH, &kp LS(FSLH)) // -_ ok 
        SHIFT_MORPH(osx_dv_ticks, &kp LS(EQUAL), &kp LS(N3)) // ` # ok 
        SHIFT_MORPH(osx_dv_alpha, &kp BSLH, &kp LS(RBKT)) // @ ^ 

                    
        ALT_MORPH(osx_dv_a, &kp A, &kp LBKT) // ok
        ALT_MORPH(osx_dv_o, &kp O, &kp SEMI) // ok
        ALT_MORPH(osx_dv_e, &kp E, &kp SQT) // ok
    };
};

 /{
   macros {
        bt_0: bt_profile_macro_0 {
            compatible = "zmk,behavior-macro";
            #binding-cells = <0>;
            bindings
                = <&out OUT_BLE>,
                  <&bt BT_SEL 0>;
        };

        bt_1: bt_profile_macro_1 {
            compatible = "zmk,behavior-macro";
            #binding-cells = <0>;
            bindings
                = <&out OUT_BLE>,
                  <&bt BT_SEL 1>;
        };

        bt_2: bt_profile_macro_2 {
            compatible = "zmk,behavior-macro";
            #binding-cells = <0>;
            bindings
                = <&out OUT_BLE>,
                  <&bt BT_SEL 2>;
        };

        bt_3: bt_profile_macro_3 {
            compatible = "zmk,behavior-macro";
            #binding-cells = <0>;
            bindings
                = <&out OUT_BLE>,
                  <&bt BT_SEL 3>;
        };
    };

    keymap {
    compatible = "zmk,keymap";
    // linux setup
    default_layer { // L0
      // ---------------------------------------------------------------------------------------------------------------------------------
      // |  F1   |  F2 |  F3 |  F4  |  F5  |                                                               |  F6   |  F7   |  F8  |   F9  |  F10 |
      // |  =    |  1  |  2  |  3   |  4   |  5   |                                                 |  6   |   7   |   8   |  9   |   0   |   -  |
      // |  TAB  |  Q  |  W  |  E   |  R   |  T   |                                                 |  Y   |   U   |   I   |  O   |   P   |   \  |
      // |  ESC  |  A  |  S  |  D   |  F   |  G   |                                                 |  H   |   J   |   K   |  L   |   ;   |   '  |
      // |   `   |  Z  |  X  |  C   |  V   |  B   | LSHFT | LCTRL | L1 | | LGUI  | RCTRL | RSHFT |  N   |   M   |   ,   |  .   |   /   | PGUP |
      // | MAGIC | HOME| END | LEFT | RIGHT|      | BSPC  | DEL   | LALT  | | RALT  | RET   | SPACE |      |  UP   | DOWN  |  [   |   ]   | PGDN |
         
      bindings = <
        &kp F1         &kp F2     &kp F3      &kp F4      &kp F5                                                                                            &kp F6  &kp F7      &kp F8      &kp F9      &kp F10
        &dv_dlr        &kp N1     &kp N2      &kp N3      &kp N4      &kp N5                                                                        &kp N6  &kp N7  &kp N8      &kp N9      &kp N0      &lt OSX_L0 SPACE
        &kp TAB        &dv_semi   &dv_comma   &dv_dot     &kp P       &kp Y                                                                         &kp F   &kp G   &kp C       &kp R       &kp L       &dv_fslh
        &kp ESC        &dv_a      &dv_o       &dv_e       &kp U       &kp I                                                                         &kp D   &kp H   &kp T       &kp N       &kp S       &dv_minus
        &kp LSHFT      &dv_sqt    &kp Q       &kp J       &kp K       &kp X   &mo NPAD    &kp LSHFT   &mo L1      &none     &kp LSHFT    &mo SYM  &kp B   &kp M   &kp W       &kp V       &kp Z       &kp RSHFT
        &mo MAGIC      &kp HOME   &kp END     &kp LEFT    &kp RIGHT           &kp BSPC    &mo FN      &kp LALT      &kp LALT  &kp RET      &kp SPACE        &kp UP  &kp DOWN    &kp LBKT    &kp RBKT    &none
      >;
    };
    num_layer { // NPAD 1
    bindings = <
      &none  &none         &none      &none      &none                                                                                        &none     &none           &none       &none         &none
      &none  &none         &none      &none      &none            &none                                                         &none         &none     &none           &none       &none         &none            
      &none  &kp LBKT      &kp SEMI   &kp SQT    &undead_caret    &dv_dlr                                                       &dv_9         &kp N7    &kp N8          &kp N9      &dv_4         &none
      &none  &sk LALT      &sk LGUI   &sk LSHFT  &sk LCTRL        &kp LS(N5)                                                    &dv_0         &kp N4    &kp N5          &kp N6      &kp FSLH      &none
      &none  &none         &kp DEL    &kp TAB    &kp BSPC         &kp RET     &trans    &none &none &none &kp LSHFT   &mo EXT   &kp N0        &kp N1    &kp N2          &kp N3      &kp LS(N7)    &none
      &none  &none         &none      &kp LEFT   &kp RIGHT                    &kp BSPC  &none &none &none &kp RET     &kp SPACE               &kp UP    &kp DOWN        &none       &none         &none
    >;
  };

  magic_layer { //MAGIC 2
    bindings = <
      &bt BT_CLR        &none               &none           &none           &none                                                                                                           &none      &none        &none      &none      &none
      &none             &none               &none           &none           &none           &none                                                                                &none      &none      &none        &none      &none      &none
      &none             &rgb_ug RGB_SPI     &rgb_ug RGB_SAI &rgb_ug RGB_HUI &rgb_ug RGB_BRI &rgb_ug RGB_TOG                                                                      &none      &none      &none        &none      &none      &none
      &bootloader       &rgb_ug RGB_SPD     &rgb_ug RGB_SAD &rgb_ug RGB_HUD &rgb_ug RGB_BRD &rgb_ug RGB_EFF                                                                      &none      &to L0    &to OSX_L0  &none      &none      &bootloader
      &sys_reset        &none               &none           &none           &none           &none           &bt_2     &bt_3     &none            &none     &none     &none       &none      &none      &none        &none      &none      &sys_reset
      &none             &none               &none           &none           &none                           &bt_0     &bt_1     &out OUT_USB     &none     &none     &none                  &none      &none        &none      &none      &none
    >;
  };
  qwerty_layer { // QWERTY 3
    bindings = <                                                                                              
    &kp F1         &kp F2   &kp F3      &kp F4      &kp F5                                                                                            &kp F6  &kp F7      &kp F8      &kp F9      &kp F10
    &kp EQUAL      &kp N1   &kp N2      &kp N3      &kp N4      &kp N5                                                                        &kp N6  &kp N7  &kp N8      &kp N9      &kp N0      &kp MINUS
    &kp TAB        &kp Q    &kp W       &kp E       &kp R       &kp T                                                                         &kp Y   &kp U   &kp I       &kp O       &kp P       &kp BSLH
    &kp ESC        &kp A    &kp S       &kp D       &kp F       &kp G                                                                         &kp H   &kp J   &kp K       &kp L       &kp SEMI    &kp SQT
    &kp GRAVE      &kp Z    &kp X       &kp C       &kp V       &kp B   &kp LSHFT   &kp LCTRL   &tog L0   &kp LGUI  &kp RCTRL &kp RSHFT        &kp N   &kp M   &kp COMMA   &kp DOT     &kp FSLH    &kp PG_UP
    &mo MAGIC      &kp HOME &kp END     &kp LEFT    &kp RIGHT           &kp BSPC    &kp DEL     &kp LALT &kp RALT  &kp RET   &kp SPACE           &kp UP  &kp DOWN    &kp LBKT    &kp RBKT    &kp PG_DN
    >;
  };
  ext_layer { // EXT 4
    bindings = <
      &none  &none     &none     &none      &none                                                                    &none    &none    &none       &none     &none
      &none  &none     &none     &none      &none     &none                                                &none     &none    &none    &none       &none     &none            
      &none  &kp ESC   &none     &kp LC(F)  &tmux_fzf &kp INS                                              &kp PG_UP &kp HOME &kp UP   &kp END     &kp CAPS  &none
      &none  &sk LALT  &sk LGUI  &sk LSHFT  &sk LCTRL &sk RALT                                             &kp PG_DN &kp LEFT &kp DOWN &kp RIGHT   &kp DEL   &none
      &none  &kp LC(Z) &kp LC(X) &kp LC(C)  &kp LGUI  &kp LC(V)  &to L0  &none &none &none &none   &none   &kp RET   &kp BSPC &kp TAB  &kp K_CMENU &kp PSCRN &none
      &none  &none     &none     &none      &none                &none   &none &none &none &kp RET &none             &kp UP   &kp DOWN &none       &none     &none
    >;
  };
  func_layer { // FN 5
    bindings = <
      &none  &none      &none        &none      &none                                                                     &none  &none    &none  &none    &none
      &none  &none      &none        &none      &none        &none                                                &none   &none  &none    &none  &none    &none            
      &none  &kp C_STOP &kp C_PREV   &kp C_PP   &kp C_NEXT   &kp C_BRI_UP                                         &kp F12 &kp F7 &kp F8   &kp F9 &kp CAPS &none
      &none  &sk LALT   &sk LGUI     &sk LSHFT  &sk LCTRL    &sk C_BRI_DN                                         &kp F11 &kp F4 &kp F5   &kp F6 &kp L1   &none
      &none  &kp C_MUTE &kp C_VOL_DN &kp LC(C)  &kp C_VOL_UP &kp LC(V)  &to L0 &none &none &none &none   &none    &kp F10 &kp F1 &kp F2   &kp F3 &to L0   &none
      &none  &none      &none        &none      &none                   &none  &none &none &none &kp RET &none            &kp UP &kp DOWN &none  &none    &none
    >;
  };
  sym_layer { // SYM 6
    bindings = <//&dv_comma   &dv_dot
      &none  &none         &none      &none      &none                                                                          &none     &none           &none       &none                     &none
      &none  &none         &none      &none      &none      &none                                                 &none         &none     &none           &none       &none                     &none            
      &none  &dv_8         &dv_alpha  &kp LS(N3) &dv_dlr    &kp LS(N5)                                            &dv_9         &dv_ticks &kp LS(COMMA)   &kp LS(DOT) &dv_4                     &none
      &none  &sk LALT      &sk LGUI   &sk LSHFT  &sk LCTRL  &undead_caret                                         &dv_0         &dv_1     &dv_5           &dv_7       &kp NON_US_BSLH          &none
      &none  &kp LS(MINUS) &kp LS(N7) &kp EQUAL  &kp GRAVE  &kp LS(N6)  &to L0 &none &none &none &none   &none    &undead_tilde &dv_2     &dv_3           &dv_6       &kp LS(NON_US_BSLH)       &none
      &none  &none         &none      &none      &none                  &none  &none &none &none &kp RET &none                  &kp UP    &kp DOWN        &kp LC(C)   &kp LC(V)                 &none
    >;
  };
  symbol_layer { // L1 7
  bindings = <
    &kp C_BRI_DN      &kp C_BRI_UP        &kp C_PREV      &kp C_NEXT      &kp C_PP                                                                                                              &kp C_MUTE       &kp C_VOL_DN &kp C_VOL_UP  &none           &kp PAUSE_BREAK
    &trans            &none               &none           &none           &none           &kp HOME                                                                              &kp LPAR        &kp KP_NUM       &kp KP_EQUAL &kp KP_DIVIDE &kp KP_MULTIPLY &kp PSCRN
    &kp LA(TAB)       &kp LBKT            &kp SEMI        &kp SQT         &none           &kp END                                                                               &kp RPAR        &kp TAB          &dv_ticks    &kp KP_N9     &dv_alpha       &kp SLCK
    &trans            &dv_perc            &dv_7           &dv_5           &dv_3           &dv_1                                                                                 &dv_9           &dv_0            &dv_2        &dv_4         &dv_6           &dv_8
    &trans            &kp K_CMENU         &none           &kp F11         &kp LC(V)       &kp LC(C)       &trans      &trans      &tog L0     &trans      &trans      &mo EXT   &dv_dlr         &undead_caret    &kp KP_N2    &kp KP_N3     &kp KP_ENTER    &trans
    &trans            &kp CAPS            &kp INS         &kp F11         &kp F12                         &trans      &trans      &trans      &trans      &trans      &kp LSFT                  &kp KP_N0        &kp KP_N0    &kp KP_DOT    &kp KP_ENTER    &trans
  >;
  };

  // osx setup
    osx_default_layer { // OSX_L0 8
      // ---------------------------------------------------------------------------------------------------------------------------------
      // |  F1   |  F2 |  F3 |  F4  |  F5  |                                                               |  F6   |  F7   |  F8  |   F9  |  F10 |
      // |  =    |  1  |  2  |  3   |  4   |  5   |                                                 |  6   |   7   |   8   |  9   |   0   |   -  |
      // |  TAB  |  Q  |  W  |  E   |  R   |  T   |                                                 |  Y   |   U   |   I   |  O   |   P   |   \  |
      // |  ESC  |  A  |  S  |  D   |  F   |  G   |                                                 |  H   |   J   |   K   |  L   |   ;   |   '  |
      // |   `   |  Z  |  X  |  C   |  V   |  B   | LSHFT | LCTRL | L1 | | LGUI  | RCTRL | RSHFT |  N   |   M   |   ,   |  .   |   /   | PGUP |
      // | MAGIC | HOME| END | LEFT | RIGHT|      | BSPC  | DEL   | LALT  | | RALT  | RET   | SPACE |      |  UP   | DOWN  |  [   |   ]   | PGDN |
         
      bindings = <
        &kp F1         &kp F2         &kp F3          &kp F4          &kp F5                                                                                                    &kp F6  &kp F7      &kp F8      &kp F9      &kp F10
        &osx_dv_dlr    &kp N1         &kp N2          &kp N3          &kp N4      &kp N5                                                                                &kp N6  &kp N7  &kp N8      &kp N9      &kp N0      &lt L0 SPACE
        &kp TAB        &osx_dv_semi   &osx_dv_comma   &osx_dv_dot     &kp P       &kp Y                                                                                 &kp F   &kp G   &kp C       &kp R       &kp L       &osx_dv_fslh
        &kp ESC        &osx_dv_a      &osx_dv_o       &osx_dv_e       &kp U       &kp I                                                                                 &kp D   &kp H   &kp T       &kp N       &kp S       &osx_dv_minus
        &kp LSHFT      &osx_dv_sqt    &kp Q           &kp J           &kp K       &kp X   &mo OSX_NPAD    &kp LSHFT   &mo OSX_L1    &none     &kp LSHFT    &mo OSX_SYM  &kp B   &kp M   &kp W       &kp V       &kp Z       &kp RSHFT
        &mo MAGIC      &kp LSHFT      &kp LCTRL       &kp LEFT        &kp RIGHT           &kp BSPC        &mo OSX_FN  &kp LALT      &kp LALT  &kp RET      &kp SPACE            &kp UP  &kp DOWN    &kp LCTRL   &kp RSHFT    &none
      >;
    };
    osx_num_layer { // OSX_NPAD 9
    bindings = <
      &none  &none         &none      &none      &none                                                                                            &none     &none           &none       &none         &none
      &none  &none         &none      &none      &none            &none                                                             &none         &none     &none           &none       &none         &none            
      &none  &kp LBKT      &kp SEMI   &kp SQT    &kp LS(RBKT)     &osx_dv_dlr                                                       &osx_dv_9     &kp N7    &kp N8          &kp N9      &osx_dv_4         &none
      &none  &sk LALT      &sk LGUI   &sk LSHFT  &sk LCTRL        &kp LS(N5)                                                        &osx_dv_0     &kp N4    &kp N5          &kp N6      &kp FSLH      &none
      &none  &none         &kp DEL    &kp TAB    &kp BSPC         &kp RET     &trans    &none &none &none &kp LSHFT   &mo OSX_EXT   &kp N0        &kp N1    &kp N2          &kp N3      &kp LS(N7)    &none
      &none  &kp LSHFT      &kp LCTRL      &kp LEFT   &kp RIGHT                    &kp BSPC  &none &none &none &kp RET     &kp SPACE                   &kp UP    &kp DOWN        &kp LCTRL   &kp RSHFT         &none
    >;
  };

  osx_qwerty_layer { // OSX_QWERTY 10
    bindings = <                                                                                              
    &kp F1         &kp F2     &kp F3      &kp F4      &kp F5                                                                                            &kp F6  &kp F7      &kp F8      &kp F9      &kp F10
    &kp EQUAL      &kp N1     &kp N2      &kp N3      &kp N4      &kp N5                                                                        &kp N6  &kp N7  &kp N8      &kp N9      &kp N0      &kp MINUS
    &kp TAB        &kp Q      &kp W       &kp E       &kp R       &kp T                                                                         &kp Y   &kp U   &kp I       &kp O       &kp P       &kp BSLH
    &kp ESC        &kp A      &kp S       &kp D       &kp F       &kp G                                                                         &kp H   &kp J   &kp K       &kp L       &kp SEMI    &kp SQT
  &kp GRAVE        &kp Z      &kp X       &kp C       &kp V       &kp B   &kp LSHFT   &kp LCTRL   &to L0   &kp LGUI  &kp RCTRL &kp RSHFT        &kp N   &kp M   &kp COMMA   &kp DOT     &kp FSLH    &kp PG_UP
  &mo MAGIC        &kp LSHFT  &kp LCTRL     &kp LEFT    &kp RIGHT           &kp BSPC    &kp DEL     &kp LALT &kp RALT  &kp RET   &kp SPACE                &kp UP  &kp DOWN    &kp LCTRL   &kp RSHFT    &kp PG_DN
  >;
  };
  osx_ext_layer { // OSX_EXT 11
    bindings = <
      &none  &none       &none        &none         &none                                                                          &none    &none    &none       &none     &none
      &none  &none       &none        &none         &none     &none                                                      &none     &none    &none    &none       &none     &none            
      &none  &kp ESC     &none        &kp LC(F)     &tmux_fzf &kp INS                                                    &kp PG_UP &kp HOME &kp LC(U)   &kp END     &kp CAPS  &none
      &none  &sk LALT    &sk LGUI     &sk LSHFT     &sk LCTRL &sk RALT                                                   &kp PG_DN &kp LEFT &kp LC(D) &kp RIGHT   &kp DEL   &none
      &none  &kp LG(Z)   &kp LG(X)    &kp LG(C)     &kp LGUI  &kp LG(V)    &to OSX_L0  &none &none &none &none   &none   &kp RET   &kp BSPC &kp TAB  &kp K_CMENU &kp PSCRN &none
      &none  &kp LSHFT  &kp LCTRL        &none         &none                  &none       &none &none &none &kp RET &none             &kp UP   &kp DOWN &kp LCTRL   &kp RSHFT     &none
    >;
  };
  osx_func_layer { // OSX_FN 12
    bindings = <
      &none         &none      &none        &none         &none                                                                           &none  &none    &none  &none    &none
      &none         &none      &none        &none         &none        &none                                                      &none   &none  &none    &none  &none    &none            
      &none         &kp C_STOP &kp C_PREV   &kp C_PP      &kp C_NEXT   &kp C_BRI_UP                                               &kp F12 &kp F7 &kp F8   &kp F9 &kp CAPS &none
      &none         &sk LALT   &sk LGUI     &sk LSHFT     &sk LCTRL    &sk C_BRI_DN                                               &kp F11 &kp F4 &kp F5   &kp F6 &kp L1   &none
      &kp LSHIFT    &kp C_MUTE &kp C_VOL_DN &kp LG(C)     &kp C_VOL_UP &kp LG(V)  &to OSX_L0 &none &none &none &none   &none    &kp F10 &kp F1 &kp F2   &kp F3 &to L0   &none
      &none         &kp LSHFT  &kp LCTRL        &none         &kp TAB                   &none      &none &none &none &kp RET &none            &kp UP &kp DOWN &kp LCTRL   &kp RSHFT    &none
    >;
  };
  osx_sym_layer { // OSX_SYM 13
    bindings = <
      &none  &none         &none          &none           &none                                                                                    &none         &none           &none       &none                     &none
      &none  &none         &none          &none           &none        &none                                                     &none             &none         &none           &none       &none                     &none            
      &none  &osx_dv_8     &osx_dv_alpha  &kp LS(N3)      &osx_dv_dlr  &kp LS(N5)                                                &osx_dv_9         &osx_dv_ticks &kp LS(COMMA)   &kp LS(DOT) &osx_dv_4                 &none
      &none  &sk LALT      &sk LGUI       &sk LSHFT       &sk LCTRL    &kp LS(RBKT)                                              &osx_dv_0         &osx_dv_1     &osx_dv_5       &osx_dv_7   &kp GRAVE                 &none
      &none  &kp LS(MINUS) &kp LS(N7)     &kp LS(RA(N7))  &kp LS(N7)   &kp LS(N6)  &to OSX_L0 &none &none &none &none   &none    &undead_tilde     &osx_dv_2     &osx_dv_3       &osx_dv_6   &kp LS(GRAVE)             &none
      &none  &kp LSHFT  &kp LCTRL          &none           &none                    &none      &none &none &none &kp RET &none                      &kp UP        &kp DOWN        &kp LG(C)   &kp LG(V)                 &none
    >;
  };
  osx_symbol_layer { // OSX_L1 14
  bindings = <
    &kp C_BRI_DN      &kp C_BRI_UP        &kp C_PREV      &kp C_NEXT      &kp C_PP                                                                                                                  &kp C_MUTE       &kp C_VOL_DN     &kp C_VOL_UP  &none           &kp PAUSE_BREAK
    &trans            &none               &none           &none           &none           &kp HOME                                                                                  &kp LPAR        &kp KP_NUM       &kp KP_EQUAL     &kp KP_DIVIDE &kp KP_MULTIPLY &kp PSCRN
    &kp LA(TAB)       &kp LBKT            &kp SEMI        &kp SQT         &none           &kp END                                                                                   &kp RPAR        &kp TAB          &osx_dv_ticks    &kp KP_N9     &osx_dv_alpha   &kp SLCK
    &trans            &kp N8              &osx_dv_7       &osx_dv_5       &osx_dv_3       &osx_dv_1                                                                                 &osx_dv_9       &osx_dv_0        &osx_dv_2        &osx_dv_4     &osx_dv_6       &osx_dv_8
    &trans            &kp K_CMENU         &none           &kp F11         &kp LC(V)       &kp LC(C)       &trans      &trans      &to L0      &trans      &trans      &mo OSX_EXT   &osx_dv_dlr     &kp LS(RBKT)     &kp KP_N2        &kp KP_N3     &kp KP_ENTER    &trans
    &trans            &kp CAPS            &kp INS         &kp F11         &kp F12                         &trans      &trans      &trans      &trans      &trans      &kp LSFT                      &kp KP_N0        &kp KP_N0        &kp KP_DOT    &kp KP_ENTER    &trans
  >;
};

};
};
